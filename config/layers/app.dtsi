// -----------------------------------------------------------------------------------------
// App switcher layer — active while G is held (OS modifier held by &ok_ltm)
// |     |     |     |     |     |     |     |     |     |     |     |
// |     |     |     |     |     |     |PREV | FWD |     |     |     |
// |     |     |     |     |     |     |     |     |     |     |     |
//             |     |     |     |     |     |     |
// N = TAB (next app), E = Shift+TAB (prev app)
app_layer {
    display-name = "App";
    bindings = <
        &trans  &trans  &trans  &trans  &trans      &trans  &trans          &trans    &trans  &trans
        &trans  &trans  &trans  &trans  &trans      &trans  &kp LS(TAB)     &kp TAB   &trans  &trans
        &trans  &trans  &trans  &trans  &trans      &trans  &trans          &trans    &trans  &trans
                        &trans  &trans  &trans      &trans  &trans          &trans
    >;
};
