// -----------------------------------------------------------------------------------------
// |  Q  |  W  | E/CMD |   R   |  T  |     |  Y  |  U  | I/CMD |  O  |  P  |
// |  A  |  S  |   D   | F     |G/APP|     |  H  |  J  |  K    |  L  |  '  |
// |  Z  |  X  |   C   |   V   |  B  |     |  N  |  M  |   ,   |  .  |  /  |
//             |       |  SPC  | DEL |     | BSPC| SPC |       |
base_layer {
    display-name = "Base";
    bindings = <
   &kp Q             &lt WIN W    &lt CMD E    &lt NUM R            &lt BT T                  &lt MEDIA Y          &lt SWITCH U          &lt CMD I             &alt_ltm APP O  &kp P
   &kp A             &kp S        &kp D        &kp F                &hml LS(LC(LALT)) G       &hmr RS(RC(RALT)) H  &kp J                 &kp K                 &kp L           &kp SQT
   &bml_shft LSHFT Z &bml LCTRL X &bml LALT C  &bml_no_qt LGUI V    &kp B                     &kp N                &bmr_no_qt RGUI M     &bmr_no_qt RALT COMMA &bmr RCTRL DOT  &bmr_shft RSHFT SLASH
                                  &trans       &lt BRAC SPACE       &lt_qt NAV DEL            &lt_qt FUNC BSPC     &lt SYM SPACE         &trans
    >;
};
