// -----------------------------------------------------------------------------------------
// |     |     |     |     |     |     |     |     |     |     |     |
// |     |     |     |     |     |     |     |     |     |     |     |
// |     |     |     |     |     |     |     | BT0 | BT1 | BT2 |     |
//             |     |     |     |     |BTCLR|     |     |
bluetooth_layer {
    display-name = "Bluetooth";
    bindings = <
   &trans      &trans       &trans       &trans       &trans           &trans       &trans           &trans          &trans          &trans
   &trans      &trans       &trans       &trans       &trans           &trans       &trans           &trans          &trans          &trans
   &trans      &trans       &trans       &trans       &trans           &trans       &bt_mac          &bt_win         &bt_and         &bt_lin
                            &trans       &trans       &trans       &bt BT_CLR       &trans           &trans
    >;
};
