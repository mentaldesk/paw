// -----------------------------------------------------------------------------------------
// | RST |  _  |  *  |  ~  |     |     |     |     |     |     |     |
// |  !  |  -  |  +  |  =  |  ^  |     |     |     |     |     |     |
// |  \  |  |  |  &  |  %  |     |     |     |     |     |     |     |
//             |     |     |     |     |     |     |
symbol_layer {
    display-name = "Command";
    bindings = <
        &trans    &trans    &trans    &trans    &trans     &trans       &trans       &trans       &trans       &trans
        &trans    &trans    &trans    &trans    &trans     &trans       &trans       &trans       &trans       &trans
        &trans    &trans    &trans    &trans    &trans     &trans       &trans       &trans       &trans       &trans
                            &trans    &trans    &trans     &trans       &trans       &trans
    >;
};
