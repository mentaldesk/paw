// -----------------------------------------------------------------------------------------
// | RST |  _  |  *  |  ~  |     |     |     |     |     |     |     |
// |  !  |  -  |  +  |  =  |  ^  |     |     |     |     |     |     |
// |  \  |  |  |  &  |  %  |     |     |     |     |     |     |     |
//             |     |     |     |     |     |     |
symbol_layer {
    display-name = "[Blank template]";
    bindings = <
        &trans    &trans    &trans    &trans    &trans     &trans       &trans       &trans       &trans       &trans
        &trans    &trans    &trans    &trans    &trans     &trans       &trans       &trans       &trans       &trans
        &trans    &trans    &trans    &trans    &trans     &trans       &trans       &trans       &trans       &trans
                            &trans    &trans    &trans     &trans       &trans       &trans
    >;
};
