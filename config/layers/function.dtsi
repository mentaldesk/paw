function_layer {
    display-name = "Function";
    bindings = <
   &kp F1      &kp F2       &kp F3       &kp F4       &trans           &trans       &trans       &trans      &trans       &bootloader
   &kp F5      &kp F6       &kp F7       &kp F8       &trans           &trans       &trans       &trans      &ok_lock     &trans
   &kp F9      &kp F10      &kp F11      &kp F12      &trans           &trans       &kp RGUI     &kp RALT    &kp RCTRL    &kp RSHFT
                            &trans       &trans       &trans           &trans       &trans       &trans
    >;
};
