// -----------------------------------------------------------------------------------------
// | RST |     |     |     |     |     |  -  |  7  |  8  |  9  |  /  |
// |     |     |     |     |     |     |  +  |  4  |  5  |  6  |  *  |
// |LSHFT|LCTRL|LALT | LGUI|     |     |  :  |  1  |  2  |  3  |  .  |
//             |     |     |     |     |BSPC |  0  |
number_layer {
    display-name = "Number";
    bindings = <
   &trans      &trans       &trans       &trans       &trans           &kp MINUS    &kp N7       &kp N8       &kp N9       &kp SLASH
   &trans      &trans       &trans       &trans       &trans           &kp PLUS     &kp N4       &kp N5       &kp N6       &kp ASTRK
   &kp LSHFT    &kp LCTRL    &kp LALT     &kp LGUI    &trans           &kp COLON    &kp N1       &kp N2       &kp N3       &kp DOT
                            &trans       &trans       &trans           &kp BSPC     &kp N0       &kp EQUAL
    >;
};
