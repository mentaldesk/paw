// -----------------------------------------------------------------------------------------
// Mirrors the Base layer by swapping the left/right halves for CAD work
mirror_layer {
    display-name = "Mirror";
    bindings = <
       &kp P     &kp O    &kp I    &kp U    &kp Y        &kp T    &kp R    &kp E    &kp W    &kp Q
       &kp SQT   &kp L    &kp K    &kp J    &kp H        &kp G    &kp F    &kp D    &kp S    &kp A
       &kp SLASH &kp DOT  &kp COMMA &kp M   &kp N        &kp B    &kp V    &kp C    &kp X    &kp Z
                         &trans    &trans  &trans       &trans   &trans   &trans
    >;
};
