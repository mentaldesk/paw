command_layer {
    display-name = "Command";
    bindings = <
        &ok_quit     &ok_close   &ok_code  &ok_redo        &ok_new_tab    &trans            &ok_underline   &ok_italic     &ok_open    &ok_print
        &ok_sel_all  &ok_save    &trans    &ok_find        &trans         &ok_find_replace  &trans          &ok_link       &trans      &trans
        &ok_undo     &ok_cut     &ok_copy  &ok_paste       &ok_bold       &ok_new_win       &trans          &ok_settings   &ok_fix     &ok_comment
                                 &trans    &ok_app_search  &trans         &trans            &ok_app_search  &trans
    >;
};
