## boards/shields/paw/Kconfig.shield
```kconfig
# Copyright (c) 2026 James Crosswell
# SPDX-License-Identifier: MIT

config SHIELD_PAW_LEFT
    def_bool $(shields_list_contains,paw_left)

config SHIELD_PAW_RIGHT
    def_bool $(shields_list_contains,paw_right)

config PAW_NATURAL_SCROLL
    bool "Enable natural (reversed) scroll direction"
    depends on SHIELD_PAW_LEFT || SHIELD_PAW_RIGHT
    default n
    help
      Enable natural scrolling (content follows finger direction) on the
      trackpad. Disabled by default for a traditional scroll feel.

config PAW_TRACKPAD_LEFT
    bool "Mount trackpad on left half"
    depends on SHIELD_PAW_LEFT || SHIELD_PAW_RIGHT
    default n
    help
      By default the trackpad is mounted on the right (peripheral) half.
      Enable this option to mount it on the left (central) half instead.
```
